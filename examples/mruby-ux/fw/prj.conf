## CMakeLists.txt
```
# SPDX-License-Identifier: BSD-3-Clause
# Zephyr/NCS application that embeds the mruby/c VM plus the generated
# UX bytecode. The mruby/c tree is staged read-only at /opt/mrubyc in the
# firmware-tools image; FW_MRUBYC_DIR lets a developer point elsewhere.
cmake_minimum_required(VERSION 3.20.0)

find_package(Zephyr REQUIRED HINTS $ENV{ZEPHYR_BASE})
project(mruby_ux)

set(MRUBYC_DIR $ENV{FW_MRUBYC_DIR})
if(NOT MRUBYC_DIR)
  set(MRUBYC_DIR /opt/mrubyc)
endif()

file(GLOB MRUBYC_CORE CONFIGURE_DEPENDS ${MRUBYC_DIR}/src/*.c)
list(REMOVE_ITEM MRUBYC_CORE ${MRUBYC_DIR}/src/hal.c)

file(GLOB FW_API CONFIGURE_DEPENDS generated/fw_api*.c)

target_sources(app PRIVATE
  src/main.c
  src/fw_api_handlers.c
  generated/ux_app_bytecode.c
  ${FW_API}
  ${MRUBYC_DIR}/hal/zephyr/hal.c
  ${MRUBYC_CORE}
)
target_include_directories(app PRIVATE
  include
  generated
  ${MRUBYC_DIR}/src
  ${MRUBYC_DIR}/hal/zephyr
)
```

## prj.conf
```kconfig
CONFIG_SERIAL=y
CONFIG_UART_CONSOLE=y
CONFIG_PRINTK=y
CONFIG_MAIN_STACK_SIZE=8192
CONFIG_HEAP_MEM_POOL_SIZE=4096
```

## src/main.c
```c
/* SPDX-License-Identifier: BSD-3-Clause
 * mruby-ux Zephyr/NCS entry point: boots the mruby/c VM on a static
 * memory pool sized by the generated fw_mruby.h, then runs the compiled
 * UX bytecode task until it exits.
 */
#include <zephyr/kernel.h>
#include <zephyr/sys/printk.h>

#include "fw_mruby.h"
#include "mrubyc.h"
#include "fw_api.h"

extern const uint8_t ux_app[];

static uint8_t memory_pool[FW_MRUBY_MEMORY_SIZE];

int
main(void)
{
	fw_api_init_all();
	mrbc_init_alloc(memory_pool, FW_MRUBY_MEMORY_SIZE);
	mrbc_init_global();
	mrbc_init_class();
	fw_api_define_all();

	mrbc_tcb *tcb = mrbc_create_task(ux_app, 0);
	if (tcb == NULL) {
		printk("SIM FAIL: task create\n");
		return 1;
	}
	mrbc_run();
	return 0;
}
```

## include/fw_api_handlers.h
```c
/* Hand-written device driver handlers for the mruby-ux device API.
 *
 * The generated fw_api_* bindings (see api/mruby-ux.mruby-api.json) call
 * these symbols after argument decoding.  Every handler/init/constructor
 * name in the spec must appear here, or the fw.mrubyc gate fails.
 */
#ifndef FW_API_HANDLERS_H
#define FW_API_HANDLERS_H

#include <stddef.h>
#include <stdint.h>

#include "mrubyc.h"

/* Symbol constants the handlers receive for symbol-typed arguments. */
enum {
	kFwHwLed1 = 0,
	kFwHwLed2,
	kFwHwLed3,
	kFwHwLedCount
};

int fw_hw_led_init(void);
int fw_hw_led_set(int32_t part, int state);
int fw_hw_led_toggle(int32_t part);
int fw_hw_led_all(const mrbc_int_t *states, size_t states_n);
int fw_hw_led_dump(char *buf, size_t cap);
int fw_hw_led_raw(mrbc_int_t idx, mrbc_float_t level);
int fw_hw_led_on_change(const mrbc_value *rest, const mrbc_value *blk);

int fw_hw_sample_open(void *data);
void fw_hw_sample_close(void *data);
int fw_hw_sample_read(void *data, mrbc_int_t ch, mrbc_float_t *buf, size_t cap);

#endif /* FW_API_HANDLERS_H */
```

## include/fw_mruby.h
```c
/* Auto-generated by `firmware mrubyc`; do not edit by hand.
 * contract: mruby-ux   mrubyc ref: 2dec4802b09be1fc12f388d3c9267ffd9dc6c404
 * Regenerate: `firmware mrubyc <name>.fw.json`
 */
#ifndef FW_MRUBY_H
#define FW_MRUBY_H

/* VM heap passed to mrbc_init_alloc(pool, FW_MRUBY_MEMORY_SIZE). */
#define FW_MRUBY_MEMORY_SIZE 40960u

#define MRBC_TICK_UNIT 10
#define MRBC_TIMESLICE_TICK_COUNT 1
#define MRBC_USE_FLOAT 2
#define MRBC_USE_MATH 0
#define MRBC_USE_STRING 1
#define MRBC_USE_STRING_UTF8 0
#define MRBC_USE_UNICODE_CASE 0
#define MAX_VM_COUNT 2
#define MAX_SYMBOLS_COUNT 255

#endif /* FW_MRUBY_H */
```

## include/fw_pins.h
```c
/* Generated by firmware-agent from mruby-ux.fw.json; do not edit. */
#ifndef FW_PINS_H
#define FW_PINS_H

#define FW_DESIGN "mruby-ux"
#define FW_MCU_PROFILE "nrf52840"

/* mode_button: P011 net BTN_MODE gpio_in */
#define FW_PIN_MODE_BUTTON 11
#define FW_PIN_MODE_BUTTON_PAD "P011"
#define FW_PIN_MODE_BUTTON_ACTIVE_LOW 1
#define FW_PIN_MODE_BUTTON_PULL_UP 1
/* status_led: P013 net LED1 gpio_out */
#define FW_PIN_STATUS_LED 13
#define FW_PIN_STATUS_LED_PAD "P013"
#define FW_PIN_STATUS_LED_ACTIVE_LOW 0
/* debug_tx: P006 net DBG_TX uart_tx */
#define FW_PIN_DEBUG_TX 6
#define FW_PIN_DEBUG_TX_PAD "P006"
#define FW_PIN_DEBUG_TX_ACTIVE_LOW 0

#define FW_PERIPH_CONSOLE_INSTANCE 0
#define FW_PERIPH_CONSOLE_BAUD 115200

#define FW_POWER_MODE_RUN 0

#endif /* FW_PINS_H */
```

## src/fw_api_handlers.c
```c
/* Hand-written device driver handlers for the mruby-ux device API.
 *
 * Reference implementation: a software LED state store so the bindings
 * behave identically on the nRF and Emscripten legs.  A product port
 * replaces these bodies with real register/GPIO access behind the same
 * signatures in fw_api_handlers.h.
 */
#include "fw_api_handlers.h"

#include <stdio.h>
#include <string.h>

static int led_state[kFwHwLedCount];

int fw_hw_led_init(void) {
	memset(led_state, 0, sizeof(led_state));
	return 0;
}

int fw_hw_led_set(const int32_t part, const int state) {
	if (part < 0 || part >= kFwHwLedCount) {
		return 0;
	}
	led_state[part] = state ? 1 : 0;
	return 1;
}

int fw_hw_led_toggle(const int32_t part) {
	if (part < 0 || part >= kFwHwLedCount) {
		return 0;
	}
	led_state[part] = !led_state[part];
	return led_state[part];
}

int fw_hw_led_all(const mrbc_int_t *states, const size_t states_n) {
	size_t applied = 0;
	for (size_t i = 0; i < states_n && i < (size_t)kFwHwLedCount; i++) {
		led_state[i] = states[i] ? 1 : 0;
		applied++;
	}
	return (int)applied;
}

int fw_hw_led_dump(char *buf, const size_t cap) {
	return snprintf(buf, cap, "LED[%d %d %d]", led_state[0], led_state[1],
			led_state[2]);
}

int fw_hw_led_raw(const mrbc_int_t idx, const mrbc_float_t level) {
	if (idx < 0 || idx >= kFwHwLedCount) {
		return -1;
	}
	led_state[idx] = level > 0.5 ? 1 : 0;
	return 0;
}

int fw_hw_led_on_change(const mrbc_value *rest, const mrbc_value *blk) {
	/* The demo keeps a single callback slot; products would queue it. */
	(void)rest;
	(void)blk;
	return 0;
}

struct fw_hw_sample {
	uint32_t seed;
	uint16_t open;
};

int fw_hw_sample_open(void *data) {
	struct fw_hw_sample *self = (struct fw_hw_sample *)data;
	self->seed = 0x1234u;
	self->open = 1u;
	return 0;
}

void fw_hw_sample_close(void *data) {
	struct fw_hw_sample *self = (struct fw_hw_sample *)data;
	self->open = 0u;
}

int fw_hw_sample_read(
	void *data, const mrbc_int_t ch, mrbc_float_t *buf, const size_t cap
) {
	const struct fw_hw_sample *self = (const struct fw_hw_sample *)data;
	if (!self->open || ch < 0 || buf == 0) {
		return -1;
	}
	const size_t n = cap < 8 ? cap : 8;
	for (size_t i = 0; i < n; i++) {
		buf[i] = (mrbc_float_t)((self->seed + (uint32_t)i * 37u) % 1024u) / 1023.0f;
	}
	return (int)n;
}
```
